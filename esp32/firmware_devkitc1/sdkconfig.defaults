## esp32/firmware_devkitc1/sdkconfig.defaults
```kconfig
# ESP32-S3-WROOM-1 N16R8 (16 MB flash, 8 MB OPI PSRAM)
CONFIG_IDF_TARGET="esp32s3"

# NimBLE peripheral (not Bluedroid)
CONFIG_BT_ENABLED=y
CONFIG_BT_NIMBLE_ENABLED=y
CONFIG_BT_BLUEDROID_ENABLED=n
CONFIG_BT_CONTROLLER_ENABLED=y

# Flash / PSRAM (N16R8 module)
CONFIG_ESPTOOLPY_FLASHSIZE_16MB=y
CONFIG_SPIRAM=y
CONFIG_SPIRAM_MODE_OCT=y
CONFIG_SPIRAM_SPEED_80M=y

# Logging
CONFIG_LOG_DEFAULT_LEVEL_INFO=y

# FreeRTOS
CONFIG_FREERTOS_HZ=1000
```

## esp32/firmware_xiao_esp32s3r8/sdkconfig.defaults
```kconfig
# XIAO ESP32-S3R8 (8 MB flash, 8 MB OPI PSRAM)
CONFIG_IDF_TARGET="esp32s3"

# NimBLE peripheral (not Bluedroid)
CONFIG_BT_ENABLED=y
CONFIG_BT_NIMBLE_ENABLED=y
CONFIG_BT_BLUEDROID_ENABLED=n
CONFIG_BT_CONTROLLER_ENABLED=y

# Flash / PSRAM
CONFIG_ESPTOOLPY_FLASHSIZE_8MB=y
CONFIG_SPIRAM=y
CONFIG_SPIRAM_MODE_OCT=y
CONFIG_SPIRAM_SPEED_80M=y

# Logging
CONFIG_LOG_DEFAULT_LEVEL_INFO=y

# FreeRTOS
CONFIG_FREERTOS_HZ=1000

# USB console — do not mux UART0 onto D6/D7 (GPIO43/44); D7 is the button wake pin.
CONFIG_ESP_CONSOLE_USB_SERIAL_JTAG=y
# CONFIG_ESP_CONSOLE_UART_DEFAULT is not set
CONFIG_ESP_CONSOLE_SECONDARY_NONE=y
```
